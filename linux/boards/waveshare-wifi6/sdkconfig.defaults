## linux/boards/waveshare-wifi6/sdkconfig.defaults
```kconfig
CONFIG_ESPTOOLPY_FLASHSIZE_32MB=y
CONFIG_ESPTOOLPY_FLASHSIZE="32MB"
CONFIG_ESP_CONSOLE_UART_DEFAULT=y
CONFIG_ESP_CONSOLE_SECONDARY_NONE=y
```

## linux/buildroot-external/package/ble-kbd/Config.in
```kconfig
config BR2_PACKAGE_BLE_KBD
	bool "Tab5 BLE keyboard client (ble-kbd)"
	help
	  BLE HID-over-GATT keyboard client for the C6 hci0 over SDIO
	  (#41).  BlueZ needs fork() so it cannot build on this NOMMU
	  target; ble-kbd speaks the kernel mgmt socket, an L2CAP ATT
	  channel and /dev/uhid directly, and stores bonds in the boot
	  FAT where bootsyncd persists them.
```

## linux/buildroot-external/package/cam-dump/Config.in
```kconfig
config BR2_PACKAGE_CAM_DUMP
	bool "cam-dump one-shot camera frame tool"
	help
	  Captures one 1280x720 RAW8 frame from /dev/cam0
	  (esp32p4-csi-cam): arms the pipeline, writes the SC202CS
	  init table + stream-on over SCCB on /dev/i2c-0, dumps the
	  frame and prints stats.  Tab5 only: needs the SC2356 camera
	  and the cam0 misc device.
```

## linux/buildroot-external/package/hci-tools/Config.in
```kconfig
config BR2_PACKAGE_HCI_TOOLS
	bool "Tab5 raw-HCI tools (hci-scan/hci-adv)"
	help
	  LE passive scanner and advertiser for the C6 hci0 over SDIO
	  (#34).  BlueZ needs fork() so it cannot build on this NOMMU
	  target; these two tools speak the raw HCI socket ABI
	  (AF_BLUETOOTH/HCI_CHANNEL_USER) directly.
```

## linux/buildroot-external/package/m5-key/Config.in
```kconfig
config BR2_PACKAGE_M5_KEY
	bool "m5-key touch/key event helper"
	help
	  Prints one console input event (a tty byte or a touchscreen
	  tap mapped to a console cell) for the m5-config touch menus
	  (#42).  Tab5 only: it needs the panel console and the ST712x
	  touchscreen.
```

## linux/buildroot-external/package/p4-demo/Config.in
```kconfig
config BR2_PACKAGE_P4_DEMO
	bool "P4 status and TCP demo"
	help
	  Small native C application for system status and a checked TCP exchange.
	  Uses one process with bounded socket waits, suitable for NOMMU Linux.
```

## linux/buildroot-external/package/pcm-play/Config.in
```kconfig
config BR2_PACKAGE_PCM_PLAY
	bool "Tab5 raw-ioctl file player"
	help
	  Plays a raw S16_LE stereo 48 kHz file through
	  /dev/snd/pcmCND0p using only the SNDRV_PCM ioctl ABI --
	  the NOMMU-static aplay-file stand-in for the ES8388/I2S0
	  bring-up (#24).  Streams the file in chunks; pairs with
	  pcm-rec for record-then-playback checks.
```

## linux/buildroot-external/package/pcm-rec/Config.in
```kconfig
config BR2_PACKAGE_PCM_REC
	bool "Tab5 raw-ioctl recorder"
	help
	  Records a few seconds from /dev/snd/pcmCND0c using only the
	  SNDRV_PCM ioctl ABI -- the NOMMU-static arecord stand-in for
	  the ES7210/I2S0 mic bring-up (#24/B12).  Includes a Goertzel
	  analyzer so the speaker->mic loopback tone can be verified
	  on the board itself.
```

## linux/buildroot-external/package/pcm-sine/Config.in
```kconfig
config BR2_PACKAGE_PCM_SINE
	bool "Tab5 raw-ioctl sine player"
	help
	  Plays a short sine through /dev/snd/pcmC0D0p using only the
	  SNDRV_PCM ioctl ABI -- the NOMMU-static aplay stand-in for the
	  ES8388/I2S0 bring-up (#24), since alsa-utils needs fork() and
	  tinyalsa needs dynamic linking.
```

## linux/buildroot-external/package/touch-dots/Config.in
```kconfig
config BR2_PACKAGE_TOUCH_DOTS
	bool "Tab5 touch-to-dot demo"
	help
	  Reads evdev touch events (ST712x on /dev/input/event0) and
	  draws a white dot on /dev/fb0 at each touched position (#33).
	  Installed only on Tab5 lab builds, where the panel and touch
	  controller exist.
```

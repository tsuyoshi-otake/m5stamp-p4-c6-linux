## linux/buildroot-external/Config.in
```kconfig
menu "EasyStick Stamp-P4 board options"

source "$BR2_EXTERNAL_EASYSTICK_STAMP_P4_PATH/package/esp-hosted-ng/Config.in"
source "$BR2_EXTERNAL_EASYSTICK_STAMP_P4_PATH/package/m5stamp-smp-smoke/Config.in"
source "$BR2_EXTERNAL_EASYSTICK_STAMP_P4_PATH/package/m5stamp-smp-stress/Config.in"
source "$BR2_EXTERNAL_EASYSTICK_STAMP_P4_PATH/package/micropython-nommu/Config.in"

config BR2_PACKAGE_EASYSTICK_STAMP_P4_M1
	bool "M1 minimal native Linux profile"
	default y
	help
	  Enables the read-only BusyBox profile used for the first P4 boot.
	  C6 SDIO, SSH, and USB gadget support are intentionally separate
	  milestones and are not selected here.

config BR2_PACKAGE_EASYSTICK_STAMP_P4_M2
	bool "M2 C6 SDIO Wi-Fi profile"
	select BR2_PACKAGE_ESP_HOSTED_NG
	select BR2_PACKAGE_WPA_SUPPLICANT
	select BR2_PACKAGE_IW
	help
	  Enables the experimental Stamp AddOn C6 SDIO host module and the
	  networking tools used during M2 bring-up.  This does not claim that
	  the C6 slave image or wlan0 has been validated on hardware.

endmenu
```

## linux/buildroot-external/package/boot-commit/Config.in
```kconfig
config BR2_PACKAGE_EASYSTICK_BOOT_COMMIT
	bool "EasyStick boot image A/B commit helper"
	help
	  Installs the privileged helper that copies a validated 256 KiB boot
	  image to PSRAM and publishes a CRC-protected commit request for the
	  boot shim.  The shim applies the image to its inactive flash slot on
	  the next normal reboot.
```

## linux/buildroot-external/package/busybox-su/Config.in
```kconfig
config BR2_PACKAGE_BUSYBOX_SU
	bool "setuid su-only BusyBox"
	depends on BR2_PACKAGE_BUSYBOX
	help
	  A third minimal BusyBox that contains only the su applet,
	  installed setuid root as /bin/busybox-su with /bin/su linked
	  to it (#37).  The main BusyBox keeps CONFIG_SU unset: it is
	  close to the 512 KB NOMMU allocation, and a separate binary
	  keeps su out of its size budget.
```

## linux/buildroot-external/package/busybox-udhcpc/Config.in
```kconfig
config BR2_PACKAGE_BUSYBOX_UDHCPC
	bool "BusyBox build for udhcpc only"
	depends on BR2_PACKAGE_BUSYBOX
	help
	  A dedicated minimal BusyBox carrying only the udhcpc applet.
	  udhcpc stays resident for the lease lifetime, and on NOMMU each
	  process holds a private copy of its binary's text, so a dedicated
	  ~100 KB image replaces the ~500 KB full BusyBox the client used to
	  occupy (#45).  Not merged into busybox-daemons so init, syslogd
	  and inetd do not grow.
```

## linux/buildroot-external/package/esp-hosted-ng/Config.in
```kconfig
config BR2_PACKAGE_ESP_HOSTED_NG
	bool "ESP-Hosted-NG SDIO host module"
	depends on BR2_LINUX_KERNEL
	depends on BR2_PACKAGE_BUSYBOX
	select BR2_PACKAGE_WPA_SUPPLICANT
	select BR2_PACKAGE_IW
	help
	  Build the locked ESP-Hosted-NG Linux host driver for the Stamp AddOn
	  C6 SDIO transport.  The package is only selected by the M2 profile.
```

## linux/buildroot-external/package/m5stamp-smp-smoke/Config.in
```kconfig
config BR2_PACKAGE_M5STAMP_SMP_SMOKE
	bool "M5Stamp L3 SMP smoke helper"
	help
	  Installs the test-only helper used by the C68 L3 smoke shot.  It
	  verifies CPU topology, runs bounded CPU1-affine userspace work, and
	  invokes the kernel's /proc/m5stamp_smp_smoke cross-call endpoint.
```

## linux/buildroot-external/package/m5stamp-smp-stress/Config.in
```kconfig
config BR2_PACKAGE_M5STAMP_SMP_STRESS
	bool "M5Stamp bounded SMP stress helper"
	select BR2_PACKAGE_M5STAMP_SMP_SMOKE
	help
	  Installs the C68-only bounded process and SMP stress helper.  It
	  exercises CPU1 affinity, fork/exec, bounded memory activity, the
	  m5stamp cross-call endpoint, and BusyBox top snapshots.
```

## linux/buildroot-external/package/mdns-answer/Config.in
```kconfig
config BR2_PACKAGE_MDNS_ANSWER
	bool "Stamp-P4 minimal mDNS responder"
	help
	  Answers mDNS A queries for <hostname>.local with the IPv4 address
	  of wlan0.  No service discovery.  Unlike mdnsd and avahi it does
	  not fork, so it runs on NOMMU.
```

## linux/buildroot-external/package/micropython-nommu/Config.in
```kconfig
config BR2_PACKAGE_MICROPYTHON_NOMMU
	bool "micropython-nommu"
	help
	  MicroPython port for RV32 NOMMU Linux (statically linked).
```

## linux/buildroot-external/package/respawn/Config.in
```kconfig
config BR2_PACKAGE_EASYSTICK_RESPAWN
	bool "EasyStick daemon respawn helper"
	help
	  Restarts a daemon whenever it exits.  Replaces shell respawn
	  loops, which on NOMMU each cost a full private copy of BusyBox.
```

## linux/buildroot-external/package/run-system/Config.in
```kconfig
config BR2_PACKAGE_RUN_SYSTEM
	bool "Stamp-P4 system-side mark helper"
	help
	  run-system marks the calling task (and everything it forks or
	  execs) as system work for the #51 NOMMU user-pool reserve gate,
	  then execs its argument command.  Init scripts use it so a
	  user-started restart (console or SSH) does not keep the ctty/
	  dropbear "user" classification and get gated.  On kernels without
	  the mark the prctl fails and the command still runs.
```
